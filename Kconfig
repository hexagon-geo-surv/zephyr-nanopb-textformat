## Kconfig
```kconfig
# Copyright (c) 2026 Rodrigo Peixoto
# SPDX-License-Identifier: Apache-2.0

config NANOPB_TEXTFORMAT
	bool "Protobuf text format for nanopb messages"
	depends on NANOPB
	help
	  Parse a subset of the protobuf text format
	  (https://protobuf.dev/reference/protobuf/textformat-spec/) directly
	  into a nanopb-generated struct, and print such a struct back out.

	  Intended for hand-typed input, e.g. a Zephyr shell command:

	    cfg set delay: 100, threshold: 500

	  Everything accepted is valid text format that protobuf's own parser
	  accepts. See docs/dialect.md for the exact subset.

if NANOPB_TEXTFORMAT

config NANOPB_TEXTFORMAT_PARSE
	bool "Parse text format into a struct"
	default y
	help
	  Build pb_tf_parse() and pb_tf_merge().

	  Turn this off for a firmware that only ever prints -- reporting a
	  configuration, say, without accepting one. The parser is the larger half
	  by some margin, so this is the bigger of the two savings.

	  With this off, none of them are declared, so a call to any is a compile
	  error naming the function rather than a link failure.

config NANOPB_TEXTFORMAT_PRINT
	bool "Print a struct as text format"
	default y
	# The printer's requirement, not the module's: it escapes non-printable
	# bytes as three-digit octal, and CBPRINTF_NANO has no %o conversion at all
	# -- it emits "\12" where "\012" is required, which re-parses wrongly
	# whenever the next byte is a digit. Depending on the choice member is the
	# only way to say this in Kconfig; it cannot be selected. A parse-only
	# build has no such need and works under CBPRINTF_NANO.
	depends on CBPRINTF_COMPLETE
	help
	  Build the printer: pb_tf_print_styled(), pb_tf_print_buf_styled() and the
	  eight style-named wrappers over them.

	  Turn this off for a firmware that only ever accepts a message -- applying
	  a configuration without reporting one back.

	  With this off, the two functions are not declared, so a call to either is
	  a compile error naming the function rather than a link failure.

config NANOPB_TEXTFORMAT_FLOAT
	bool "Parse and print float and double fields"
	default y
	depends on !MINIMAL_LIBC
	# Only the printer needs floating-point formatting, and CBPRINTF_PRINT
	# already carries the CBPRINTF_COMPLETE dependency that FP_SUPPORT itself
	# requires. Parsing a float needs strtod() instead, hence !MINIMAL_LIBC.
	select CBPRINTF_FP_SUPPORT if NANOPB_TEXTFORMAT_PRINT
	help
	  Enable float/double support. Parsing needs strtod(), which the minimal
	  libc does not provide, hence the dependency. Printing needs
	  CBPRINTF_FP_SUPPORT, which this selects.

	  When disabled, a float or double field reports PB_TF_ERR_NO_FLOAT in
	  both directions rather than failing the build, and neither strtod() nor
	  floating-point formatting is referenced, so neither is linked.

	  Measured on mps2/an385 at -Os, this saves 8 KB of flash in the sample
	  and 12 KB in the test application, and no RAM in either. How much you
	  get back depends on whether something else in your image already
	  formats floating point.

	  Note: messages with genuine 64-bit fields additionally need
	  CBPRINTF_FULL_INTEGRAL, which is the Kconfig default. Narrower fields do
	  not -- the printer uses width-correct conversions (PRIu32 and friends),
	  so only fields wider than 32 bits depend on it, and such a field reports
	  PB_TF_ERR_UNSUPPORTED if it is unavailable.

config NANOPB_TEXTFORMAT_PRINT_SKIP_DEFAULTS
	bool "Omit implicit-presence fields that are still zero"
	depends on NANOPB_TEXTFORMAT_PRINT
	help
	  Leave out singular and required fields whose value is the type's
	  default, as protoc's own printer does.

	  Off by default, so a printed message shows every field and round-trips
	  byte-exact into a cleared struct. Note this never hides an optional
	  field that was explicitly set to zero -- presence is tracked
	  separately -- nor an empty repeated field, which has nothing to print.

config NANOPB_TEXTFORMAT_MAX_DEPTH
	int "Maximum submessage nesting depth"
	default 8
	range 1 32
	help
	  Submessage nesting limit for both the parser and the printer.
	  Exceeding it reports PB_TF_ERR_DEPTH.

	  The parser is iterative: nesting costs one entry in a fixed array
	  inside a single stack frame, not a frame per level. Measured on
	  Cortex-M3 at -Os, pb_tf_parse() costs 132 bytes plus 20 per level, so
	  the default 8 is 296 bytes and the maximum 32 is 776 -- worth knowing
	  against CONFIG_SHELL_STACK_SIZE, which defaults to 2048. Raising this
	  is linear and visible in one -fstack-usage line.

module = NANOPB_TEXTFORMAT
module-str = nanopb_textformat
source "subsys/logging/Kconfig.template.log_config"

endif # NANOPB_TEXTFORMAT
```
